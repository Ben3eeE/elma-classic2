## esp32/sdkconfig.defaults
```kconfig
# ESP32-S3 Disobey 2025 Badge Configuration

# CPU
CONFIG_ESP32S3_DEFAULT_CPU_FREQ_240=y

# PSRAM (Octal SPI, 80MHz)
CONFIG_SPIRAM=y
CONFIG_SPIRAM_MODE_OCT=y
CONFIG_SPIRAM_SPEED_80M=y
CONFIG_SPIRAM_MALLOC_ALWAYSINTERNAL=4096
CONFIG_SPIRAM_MALLOC_RESERVE_INTERNAL=32768
CONFIG_SPIRAM_TRY_ALLOCATE_WIFI_LWIP=n

# Compiler optimization
CONFIG_COMPILER_OPTIMIZATION_PERF=y

# C++ exceptions (used by game code)
CONFIG_COMPILER_CXX_EXCEPTIONS=y

# Flash (QIO, 80MHz for fast memory-mapped reads)
CONFIG_ESPTOOLPY_FLASHMODE_QIO=y
CONFIG_ESPTOOLPY_FLASHFREQ_80M=y
CONFIG_ESPTOOLPY_FLASHSIZE_16MB=y

# Partition table
CONFIG_PARTITION_TABLE_CUSTOM=y
CONFIG_PARTITION_TABLE_CUSTOM_FILENAME="partitions.csv"

# Stack size (game uses recursion in physics)
CONFIG_ESP_MAIN_TASK_STACK_SIZE=16384

# Watchdog - disable for main task (rendering can be slow)
CONFIG_ESP_TASK_WDT_TIMEOUT_S=30
```
